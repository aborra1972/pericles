## firmware/sdkconfig.defaults.n16r8
```kconfig
# ESP32-S3 N16R8 sdkconfig defaults
# 16MB Flash + 8MB PSRAM configuration

# Flash configuration (board-specific)
CONFIG_ESPTOOLPY_FLASHSIZE_16MB=y
CONFIG_ESPTOOLPY_FLASHMODE_QIO=y
CONFIG_ESPTOOLPY_FLASHFREQ_80M=y

# PSRAM configuration
CONFIG_SPIRAM=y
CONFIG_SPIRAM_MODE_QUAD=y
CONFIG_SPIRAM_SPEED_80M=y

# Partition table
CONFIG_PARTITION_TABLE_CUSTOM=y
CONFIG_PARTITION_TABLE_CUSTOM_FILENAME="partitions.csv"

# FreeRTOS
CONFIG_FREERTOS_HZ=1000

# Timer task
CONFIG_ESP_TIMER_TASK_STACK_SIZE=4096

# BLE
CONFIG_BT_ENABLED=y
CONFIG_BT_NIMBLE_ENABLED=y
CONFIG_BT_NIMBLE_MAX_CONNECTIONS=1

# WiFi
CONFIG_ESP_WIFI_STATIC_RX_BUFFER_NUM=10
CONFIG_ESP_WIFI_DYNAMIC_RX_BUFFER_NUM=32
CONFIG_ESP_WIFI_DYNAMIC_TX_BUFFER_NUM=32

# HTTP Client
CONFIG_ESP_HTTP_CLIENT_ENABLE_HTTPS=y

# Log level
CONFIG_LOG_DEFAULT_LEVEL_INFO=y

# SPIFFS (for skin cache)
CONFIG_SPIFFS_MAX_PARTITIONS=3
```
